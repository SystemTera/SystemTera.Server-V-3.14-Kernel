## Documentation/devicetree/bindings/misc/ge_counter.txt
```
Device-Tree bindings for misc/ge_counter.c GPIO event counter

Required properties:
	- compatible = "ginzinger,ge_counter";

Each counter is represented as a sub-node:
Required subnode property:
	- gpios: OF device-tree gpio specification

Optional subnode-properties:
	- label: descriptive name of the counter (default: node name)
	- irq-type (default: IRQ_TYPE_EDGE_RISING)
	  (see include/dt-bindings/interrupt-controller/irq.h)
	- interval in [ms] (default: 0) to enable interval counting


Example nodes:

	counter {
		compatible = "ginzinger,ge_counter";

		di0 {
			label = "di0";
			gpios = <&gpio6 2 GPIO_ACTIVE_HIGH>;
			irq-type = <IRQ_TYPE_EDGE_RISING>;
			interval = <0>; // ms
		};

		...
	};
```

## Documentation/devicetree/bindings/misc/ge_switch_gpio.txt
```
Device-Tree bindings for misc/switch/ge_switch_gpio.c GPIO dip/hex switch driver

Required properties:
	- compatible = "ginzinger,ge_switch_gpio";


Each switch is represented as sub-node:
Optional switch sub-node-properties:
	- label: descriptive name of the switch (default: node name)

A switch consists of a multiple number of pins (sub-nodes of switch):
Required pin sub-node property:
	- gpios: OF device-tree gpio specification
	- mask: bitmask determining which bit of resulting value is filled with state of specified GPIO



Example nodes:

	switches {
		compatible = "ginzinger,ge_switch_gpio";

		bt_hardware_version {
			label = "bt_hardware_version";

			gpio_switch_hw1 {
				gpios = <&gpio1 5 GPIO_ACTIVE_HIGH>;
				mask = <1>;
			};
			gpio_switch_hw2 {
				gpios = <&gpio1 7 GPIO_ACTIVE_HIGH>;
				mask = <2>;
			};
			gpio_switch_hw3 {
				gpios = <&gpio1 8 GPIO_ACTIVE_HIGH>;
				mask = <4>;
			};

			...
		};

		...
	};
```

## fs/Kconfig.rej
```kconfig
--- fs/Kconfig
+++ fs/Kconfig
@@ -208,6 +208,7 @@
 source "fs/exofs/Kconfig"
 source "fs/f2fs/Kconfig"
 source "fs/efivarfs/Kconfig"
+source "fs/aufs/Kconfig"
 
 endif # MISC_FILESYSTEMS
 
```
